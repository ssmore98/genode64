## sell4.its
```
/*
 * Simple U-Boot uImage source file containing a single kernel
 */

/dts-v1/;

/ {
	description = "Simple image with single seL4 kernel on x86";
	#address-cells = <1>;

	images {
		kernel {
			description = "seL4 kernel";
			data = /incbin/("./build/x86_64/var/libcache/kernel-sell4-pc/kernel.elf");
			type = "kernel";
			arch = "x86_64";
			os = "linux";
			compression = "lzo";
			load = <0x01000000>;
			entry = <0x00000000>;
			hash-2 {
				algo = "sha1";
			};
		};

	};

	configurations {
		default = "config-1";
		config-1 {
			description = "Boot seL4 kernel";
			kernel = "kernel";
		};
	};
};
```
